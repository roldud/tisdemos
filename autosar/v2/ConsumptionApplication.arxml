AUTOSAR XML (schema 00050)
standard types defined: sint16, sint32, sint16_DataConstr, sint32_DataConstr
package /ComponentTypes
  application sw component type ConsumptionApplication
    provide/require port TankPort: provided-com-specs=[data-element=currentTankInML, data-element=lastTankInML], provided-required-interface=TankInterface
      required-com-specs:
        data-element=currentTankInML, filter=data-filter-type=ALWAYS
        data-element=lastTankInML, filter=data-filter-type=ALWAYS
    provide/require port TravelPort: provided-com-specs=[data-element=estimatedConsumption, data-element=estimatedKMRemaining], provided-required-interface=TravelInterface
      required-com-specs:
        data-element=estimatedConsumption, filter=data-filter-type=ALWAYS
        data-element=estimatedKMRemaining, filter=data-filter-type=ALWAYS
    behavior ConsumptionApplication_InternalBehavior
      runnable EstimateConsumption
        data-receive-point-by-arguments:
          access REC_TankPort_currentTankInML: accessed-variable=TankPort.currentTankInML
          access REC_TankPort_lastTankInML: accessed-variable=TankPort.lastTankInML
          access REC_TravelPort_estimated_km_remaining: accessed-variable=TravelPort.estimatedKMRemaining
        data-send-points:
          access SEND_TankPort_lastTankInML: accessed-variable=TankPort.lastTankInML
          access SEND_TravelPort_estimatedConsumption: accessed-variable=TravelPort.estimatedConsumption
  swc implementation ConsumptionApplication_Implementation: behavior=ConsumptionApplication_InternalBehavior
    code-descriptors:
      code Default: artifact-descriptors=autosar-engineering-object={short-label=Default, category=SWSRC}
package /PortInterfaces
  sender receiver interface TankInterface
    data currentTankInML: range raw 0..100000, type=sint32
    data lastTankInML: range raw 0..100000, type=sint32
    invalidation-policys:
      data-element=lastTankInML, handle-invalid=DONT-INVALIDATE
      data-element=currentTankInML, handle-invalid=DONT-INVALIDATE
  sender receiver interface TravelInterface
    data estimatedConsumption: range raw 0..2147483647, type=sint32
    data estimatedKMRemaining: range raw 0..1000, type=sint16
    invalidation-policys:
      data-element=estimatedKMRemaining, handle-invalid=DONT-INVALIDATE
      data-element=estimatedConsumption, handle-invalid=DONT-INVALIDATE
